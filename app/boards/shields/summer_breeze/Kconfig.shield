## app/boards/shields/summer_breeze/Kconfig.shield
```kconfig
# Copyright (c) 2020 Pete Johanson
# SPDX-License-Identifier: MIT

config SHIELD_BREEZE_LEFT
	def_bool $(shields_list_contains,summer_breeze_left)

config SHIELD_BREEZE_RIGHT
	def_bool $(shields_list_contains,summer_breeze_right)
```
